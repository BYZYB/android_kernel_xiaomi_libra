## drivers/input/fingerprint/Kconfig
```kconfig
menuconfig INPUT_FINGERPRINT
	bool "Fingerprint"
	default n
	help
	  Say Y here, and a list of supported fingerprint device drivers will be displayed.
	  If unsure, say N.

if INPUT_FINGERPRINT

config FINGERPRINT_FPC1020
	tristate "FPC1020 fingerprint support"
	depends on SPI
	help
	  Say Y here if you have an aqua device.

endif
```

## drivers/platform/xiaomi/Kconfig
```kconfig
# Xiaomi configuration options

config MACH_XIAOMI
	bool "Xiaomi device"
	depends on ARCH_MSM
	help
	 Support for Xiaomi products

config MACH_XIAOMI_MSM8992
	bool "Xiaomi MSM8992"
	depends on ARCH_MSM8992
	select MACH_XIAOMI
	help
	 Support for MSM8992 Xiaomi variants

menu "Xiaomi board selection"

config MACH_LIBRA
	bool "Libra board variant"
	select MACH_XIAOMI_MSM8992
	help
	 Support for Xiaomi Libra variant

endmenu
```
